## Kconfig
```kconfig
config ZMK_KEY_EVENTS_GATT
    bool "Report key positions and active layers over a BLE GATT service"
    default y
    depends on ZMK_BLE && (!ZMK_SPLIT || ZMK_SPLIT_ROLE_CENTRAL)
    help
      Exposes a GATT characteristic that notifies the host each time a
      physical key position is pressed or released, and whenever the set of
      active layers changes. Used by the Imprint companion app.
```

## dts/bindings/imprint,input-processor-tuner.yaml
```yaml
description: |
  Input processor for the Imprint trackballs whose settings (cursor or scroll
  mode, speed, axes, acceleration) can be changed at runtime over BLE and are
  saved in flash. The parameter selects the settings slot: 0 = left, 1 = right.

compatible: "imprint,input-processor-tuner"

include: ip_one_param.yaml
```
